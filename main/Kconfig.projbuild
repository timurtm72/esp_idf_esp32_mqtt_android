## main/Kconfig.projbuild
```kconfig
# put here your custom config value
menu "Example Configuration"
	config ESP_WIFI_SSID
    	string "WiFi SSID"
    	default "ASUS-LAPTOP 7006"
    	help
		SSID (network name) for the example to connect to.

	config ESP_WIFI_PASSWORD
    	string "WiFi Password"
    	default "timur_1972"
    	help
		WiFi password (WPA or WPA2) for the example to use.
endmenu
menu "MQTT Configuration"
    config MQTT_BROKER_URL
        string "MQTT Broker URL"
        default "mqtt://127.0.0.1:1883"
        help
            URL of the MQTT broker to connect to.

    config MQTT_USERNAME
        string "MQTT Username"
        default "timur"
        help
            Username for MQTT authentication.

    config MQTT_PASSWORD
        string "MQTT Password"
        default "timur_1972"
        help
            Password for MQTT authentication.
endmenu
```
